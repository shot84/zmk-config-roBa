## config/west.yml
```yaml
manifest:
  remotes:
    - name: zmkfirmware
      url-base: https://github.com/zmkfirmware
    - name: kumamuk-git
      url-base: https://github.com/kumamuk-git
    - name: prospector  # <-- Prospector Scanner
      url-base: https://github.com/t-ogura  # ★これを追加
  projects:
    - name: zmk
      remote: zmkfirmware
      revision: v0.3-branch
      import: app/west.yml
    - name: zmk-pmw3610-driver
      remote: kumamuk-git
      revision: main
    - name: prospector-zmk-module
      remote: prospector
      revision: v1.0.0
      path: modules/prospector-zmk-module
  self:
    path: config

# prospector forked version
# manifest:
#   remotes:
#     - name: zmkfirmware
#       url-base: https://github.com/zmkfirmware
#     - name: prospector
#       url-base: https://github.com/t-ogura
#   projects:
#     - name: zmk
#       remote: zmkfirmware
#       revision: v0.3-branch
#       import: app/west.yml
#     - name: prospector-zmk-module
#       remote: prospector
#       revision: v2.0.0
#       path: modules/prospector-zmk-module
#   self:
#     path: config
```
